## firmware/main/Kconfig.projbuild
```kconfig
menu "YAMNet demo"
    config YAMNET_DUMP
        bool "Print every patch's int8 input and output (read by tools/check_dump.py)"
        default n
endmenu
```
